//Team SpaceHive - Servo-actuated rocket fins through an Arduino Nano
//Authors: Elena Coghe, Claudia Angelo, Micol Favretto, Matilde Rizzo

//This code controls the fins by exploiting the feedback linearization technique: every time the rocket is not properly aligned 
//with the z axis and suffers from a roll or pitch rotation due to the wind, the implemented PD controller
//(to which the system is linear and contains an integral action thanks to the feedback linearization) returns an input that prompts
//the servos to rotate, so that the moment generated by the effect of the wind is compensated.

#include <Servo.h>
#include <PID_v1.h>
#include <MadgwickAHRS.h>
#include <Arduino_LSM6DS3.h>
#include "feed_lin.h"

//System specs, PID parameters, servos

#define INPUT_PIN 0
float Ix, b, C_alpha, K_ail, delta_max; //To be set following structural analysis      
double Setpoint, Input, Output;
double Kp = 0.21, Ki = 0.0, Kd = 0.96;
float f = 0, g = 0, u_bar = 0; //Starting conditions to be modified; feedback linearization library takes care of all them online with the exception of g, which is static

PID myPID(&Input, &Output, &Setpoint, Kp, Ki, Kd, DIRECT); //Negative feedback loop
Madgwick filter; //Filter for IMU data; better performance than a standard Kalman filter for space applications
Feedback_lin myfeed(f, g, u_bar);

Servo myServoA;
Servo myServoB;
Servo myServoC; 
Servo myServoD;

//IMU data
float ax, ay, az;
float gx, gy, gz;

int pos = 0;

//Initialization

void setup()
{
  Serial.begin(115200);
  while(!Serial);

  if (!IMU.begin()) {
    Serial.println("IMU not found");
    while(1);
  }
  filter.begin(104);


  Setpoint = 0;
  myServoA.attach(6);
  myServoB.attach(7);
  myServoC.attach(8);
  myServoD.attach(9);

  myPID.SetMode(AUTOMATIC);
}

//Reading and filtering data from IMU, computation and writing of the input command on servos

void loop()
{
  if ((IMU.accelerationAvailable()) && (IMU.gyroscopeAvailable())){
    IMU.readAcceleration(ax,ay,az);
    IMU.readGyroscope(gx,gy,gz);
    filter.updateIMU(gx,gy,gz,ax,ay,az);
  }
  Input = filter.getPitch(); //Due to the symmetry of the rocket, roll and pitch are equal
  myPID.Compute();
  Output = myfeed.real_u(); //The input provided by the linear regulator is converted into the command that must compensate the disturbance term in the nonlinear equation
  myServoA.write((int) Output);
  myServoB.write((int) Output);
  myServoC.write((int) Output);
  myServoD.write((int) Output);

//Float are difficult to manage for an Arduino Nano, even if the Madgwick filter library exploits them. Hence, a cast has been applied to give the inputs to the servos.


}

//To be modified and improved implementing other strategies from Control theory, such as optimal control and anti-windup scheme. As regards the starting conditions for the feedback linearization function, an online computation program should be added.
//All simulations have been
//carried out using MATLAB and Simulink.
